## conf/machine/chip.conf
```bitbake
#@TYPE: Machine
#@NAME: C.H.I.P. board
#@DESCRIPTION: Machine configuration for C.H.I.P. board

MACHINE_EXTRA_RRECOMMENDS = " kernel-modules kernel-devicetree"

EXTRA_IMAGEDEPENDS += "u-boot"

DEFAULTTUNE ?= "cortexa8t-neon"
include conf/machine/include/tune-cortexa8.inc

IMAGE_FSTYPES += "tar"

SERIAL_CONSOLE = "115200 ttyS0"

PREFERRED_PROVIDER_virtual/kernel ?= "linux-chip"
PREFERRED_PROVIDER_u-boot ?= "u-boot-chip"

KERNEL_IMAGETYPE = "zImage"
KERNEL_DEVICETREE = "sun5i-r8-chip.dtb"

SPL_BINARY = "spl/sunxi-spl.bin"
UBOOT_BINARY = "u-boot-dtb.bin"
UBOOT_MACHINE = "CHIP_defconfig"

MACHINE_FEATURES = "usbgadget usbhost wifi"

KERNEL_MODULE_AUTOLOAD += " g_cdc"

# Include wifi modules and firmware
MACHINE_EXTRA_RRECOMMENDS = "kernel-module-r8723bs rtl8723bs"
```
